#include "SSD1306.h"

// <------  Down
const uint8_t charmap5x7[128][6] PROGMEM = {
        {0x00, 0x00, 0x00, 0x00, 0x00},            // Code for char NULL
        {0x38, 0x10, 0x08, 0x04, 0x0E},            // Code for char Saw
        {0x18, 0x14, 0x12, 0x14, 0x18},            // Code for char Triangle
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        {0x00, 0x00, 0x00, 0x00, 0x00}             // Code for char DEL
};

const uint8_t charmap10x15[19][12][2] PROGMEM = {
        {{0x00, 0x00}, {0x00, 0x00}, {0x00, 0x00}, {0x00, 0x00}, {0x00, 0x00}, {0x00, 0x00}, {0x00, 0x00}, {0x00, 0x00}, {0x00, 0x00}, {0x00, 0x00}, {0x00, 0x00}, {0x00, 0x00}},  // 0ode for char Space
        {{0x00, 0x00}, {0x00, 0x00}, {0x30, 0x66}, {0xFC, 0x7F}, {0xFF, 0x1F}, {0x33, 0x06}, {0x30, 0x06}, {0x30, 0x06}, {0x30, 0x66}, {0xFC, 0x7F}, {0xFF, 0x1F}, {0x33, 0x06}},  // Code for char #
        {{0x00, 0x00}, {0x00, 0x00}, {0xFC, 0x1F}, {0xFE, 0x3F}, {0x07, 0x76}, {0x03, 0x63}, {0x83, 0x61}, {0xC3, 0x60}, {0x63, 0x60}, {0x37, 0x70}, {0xFE, 0x3F}, {0xFC, 0x1F}},  // Code for char 0
        {{0x00, 0x00}, {0x00, 0x00}, {0x00, 0x60}, {0x38, 0x60}, {0x1C, 0x60}, {0x0E, 0x60}, {0x07, 0x60}, {0xFF, 0x7F}, {0xFF, 0x7F}, {0x00, 0x60}, {0x00, 0x60}, {0x00, 0x60}},  // Code for char 1
        {{0x00, 0x00}, {0x00, 0x00}, {0x1C, 0x70}, {0x1E, 0x78}, {0x07, 0x7C}, {0x03, 0x6E}, {0x03, 0x67}, {0x83, 0x63}, {0xC3, 0x61}, {0xE7, 0x60}, {0x7E, 0x60}, {0x3C, 0x60}},  // Code for char 2
        {{0x00, 0x00}, {0x00, 0x00}, {0x1C, 0x1C}, {0x1E, 0x3C}, {0x07, 0x70}, {0x03, 0x60}, {0xC3, 0x60}, {0xC3, 0x60}, {0xC3, 0x60}, {0xE7, 0x71}, {0xFE, 0x3F}, {0x3C, 0x1F}},  // Code for char 3
        {{0x00, 0x00}, {0x00, 0x00}, {0xE0, 0x01}, {0xF0, 0x03}, {0x38, 0x03}, {0x1C, 0x03}, {0x0E, 0x03}, {0x07, 0x03}, {0xFF, 0x7F}, {0xFF, 0x7F}, {0x00, 0x03}, {0x00, 0x03}},  // Code for char 4
        {{0x00, 0x00}, {0x00, 0x00}, {0xFF, 0x18}, {0xFF, 0x38}, {0xE3, 0x70}, {0x63, 0x60}, {0x63, 0x60}, {0x63, 0x60}, {0x63, 0x60}, {0xE3, 0x70}, {0xC3, 0x3F}, {0x83, 0x1F}},  // Code for char 5
        {{0x00, 0x00}, {0x00, 0x00}, {0xFC, 0x1F}, {0xFE, 0x3F}, {0xC7, 0x71}, {0xC3, 0x60}, {0xC3, 0x60}, {0xC3, 0x60}, {0xC3, 0x60}, {0xC7, 0x71}, {0x8E, 0x3F}, {0x0C, 0x1F}},  // Code for char 6
        {{0x00, 0x00}, {0x00, 0x00}, {0x63, 0x70}, {0x63, 0x7C}, {0x63, 0x1E}, {0x63, 0x07}, {0xC3, 0x03}, {0xC3, 0x01}, {0xE3, 0x00}, {0xF3, 0x00}, {0xBF, 0x01}, {0x9F, 0x01}},  // Code for char 7
        {{0x00, 0x00}, {0x00, 0x00}, {0x3C, 0x1F}, {0xFE, 0x3F}, {0xE7, 0x73}, {0xC3, 0x61}, {0xC3, 0x61}, {0xC3, 0x61}, {0xC3, 0x61}, {0xE7, 0x73}, {0xFE, 0x3F}, {0x3C, 0x1F}},  // Code for char 8
        {{0x00, 0x00}, {0x00, 0x00}, {0x7C, 0x18}, {0xFE, 0x38}, {0xC7, 0x71}, {0x83, 0x61}, {0x83, 0x61}, {0x83, 0x61}, {0x83, 0x61}, {0xC7, 0x71}, {0xFE, 0x3F}, {0xFC, 0x1F}},  // Code for char 9
        {{0x00, 0x00}, {0x00, 0x00}, {0xF0, 0x7F}, {0xF8, 0x7F}, {0x1C, 0x03}, {0x0E, 0x03}, {0x07, 0x03}, {0x07, 0x03}, {0x0E, 0x03}, {0x1C, 0x03}, {0xF8, 0x7F}, {0xF0, 0x7F}},  // Code for char A
        {{0x00, 0x00}, {0x00, 0x00}, {0xFF, 0x7F}, {0xFF, 0x7F}, {0xC3, 0x60}, {0xC3, 0x60}, {0xC3, 0x60}, {0xC3, 0x60}, {0xC3, 0x60}, {0xE7, 0x71}, {0xFE, 0x3F}, {0x3C, 0x1F}},  // Code for char B
        {{0x00, 0x00}, {0x00, 0x00}, {0xFC, 0x1F}, {0xFE, 0x3F}, {0x07, 0x70}, {0x03, 0x60}, {0x03, 0x60}, {0x03, 0x60}, {0x03, 0x60}, {0x07, 0x70}, {0x1E, 0x3C}, {0x1C, 0x1C}},  // Code for char C
        {{0x00, 0x00}, {0x00, 0x00}, {0xFF, 0x7F}, {0xFF, 0x7F}, {0x03, 0x60}, {0x03, 0x60}, {0x03, 0x60}, {0x03, 0x60}, {0x03, 0x60}, {0x07, 0x70}, {0xFE, 0x3F}, {0xFC, 0x1F}},  // Code for char D
        {{0x00, 0x00}, {0x00, 0x00}, {0xFF, 0x7F}, {0xFF, 0x7F}, {0xC3, 0x60}, {0xC3, 0x60}, {0xC3, 0x60}, {0xC3, 0x60}, {0xC3, 0x60}, {0x03, 0x60}, {0x03, 0x60}, {0x03, 0x60}},  // Code for char E
        {{0x00, 0x00}, {0x00, 0x00}, {0xFF, 0x7F}, {0xFF, 0x7F}, {0xC3, 0x00}, {0xC3, 0x00}, {0xC3, 0x00}, {0xC3, 0x00}, {0xC3, 0x00}, {0x03, 0x00}, {0x03, 0x00}, {0x03, 0x00}},  // Code for char F
        {{0x00, 0x00}, {0x00, 0x00}, {0xFC, 0x1F}, {0xFE, 0x3F}, {0x07, 0x70}, {0x03, 0x60}, {0xC3, 0x61}, {0xC3, 0x61}, {0xC3, 0x60}, {0xC7, 0x70}, {0xDE, 0x3F}, {0xDC, 0x1F}}   // Code for char G
};

const int8_t hexChars[16] PROGMEM = {'0', '1', '2', '3', '4', '5', '6', '7', '8', '9', 'A', 'B', 'C', 'D', 'E', 'F'};

uint8_t charToBigIndex(int8_t c){
    if(c >= '0' && c <= '9') return c - '0' + 2;
    if(c >= 'A' && c <= 'G') return c - 'A' + 12;
    if(c == '#') return 1;
    return 0;
}


void init_SSD1306(){
    COMMAND_SSD1306(0xAF); // Turn ON
    COMMAND_SSD1306(0xA4); // Display RAM
    COMMAND_SSD1306(0xA6); // Non inverted
    COMMAND_SSD1306(0xA1); // Flip Screen
    COMMAND_SSD1306(0xC8); // Mirror Screen
    COMMAND_SSD1306(0x20);
    COMMAND_SSD1306(0x02); // Page addressing mode
    COMMAND_SSD1306(0x8D);
    COMMAND_SSD1306(0x14); // Enable charge pump
}

void clear_SSD1306(){
    for(uint8_t page = 0 ; page < 8 ; page++){
        COMMAND_SSD1306(0x00);
        COMMAND_SSD1306(0x10);
        COMMAND_SSD1306(0xB0 | page);
        
        I2C_START();
        I2C_WAIT_TRASMISSION();
        I2C_WRITE(ADDR_W_SSD1306);
        I2C_WAIT_TRASMISSION();
        I2C_WRITE(0x40);
        I2C_WAIT_TRASMISSION();
        for(uint8_t i = 0; i < 128; i++){
            I2C_WRITE(0x00);
            I2C_WAIT_TRASMISSION();
        }
        I2C_STOP();
    }
}


void printChar_SSD1306(uint8_t x, uint8_t y, int8_t c, uint8_t flags){
    x *= 6;

    COMMAND_SSD1306(0x00 | (x & 0x0F));
    COMMAND_SSD1306(0x10 | (x >> 4));
    COMMAND_SSD1306(0xB0 | (y & 0x07));

    I2C_START();
    I2C_WAIT_TRASMISSION();
    I2C_WRITE(ADDR_W_SSD1306);
    I2C_WAIT_TRASMISSION();
    I2C_WRITE(0x40);
    I2C_WAIT_TRASMISSION();
    for(uint8_t i = 0; i < 6; i++){
        uint8_t byte = pgm_read_byte(&charmap5x7[c][i]);
        if(flags & ATTR_UNDERLINE) byte |= 0x80;
        if(flags & ATTR_STRICKTHR) byte |= 0x08;
        if(flags & ATTR_INVERTED) byte = ~byte;
        I2C_WRITE(byte);
        I2C_WAIT_TRASMISSION();
    }
    I2C_STOP();
}

void printStr_SSD1306(uint8_t x, uint8_t y, char* s, uint8_t flags){
    x *= 6;
    
    COMMAND_SSD1306(0x00 | (x & 0x0F));
    COMMAND_SSD1306(0x10 | (x >> 4));
    COMMAND_SSD1306(0xB0 | (y & 0x07));
    
    I2C_START();
    I2C_WAIT_TRASMISSION();
    I2C_WRITE(ADDR_W_SSD1306);
    I2C_WAIT_TRASMISSION();
    I2C_WRITE(0x40);
    I2C_WAIT_TRASMISSION();
    for(uint8_t i = 0 ; s[i] ; i++)
        for(uint8_t col = 0 ; col < 6 ; col++){
            uint8_t byte = pgm_read_byte(&charmap5x7[s[i]][col]);
            if(flags & ATTR_UNDERLINE) byte |= 0x80;
            if(flags & ATTR_STRICKTHR) byte |= 0x08;
            if(flags & ATTR_INVERTED) byte = ~byte;
            I2C_WRITE(byte);
            I2C_WAIT_TRASMISSION();
        }
    I2C_STOP();
}

void printStrBig_SSD1306(uint8_t x, uint8_t y, char* s, uint8_t flags){
    x *= 12;
    
    COMMAND_SSD1306(0x00 | (x & 0x0F));
    COMMAND_SSD1306(0x10 | (x >> 4));
    COMMAND_SSD1306(0xB0 | (y & 0x07));
    
    I2C_START();
    I2C_WAIT_TRASMISSION();
    I2C_WRITE(ADDR_W_SSD1306);
    I2C_WAIT_TRASMISSION();
    I2C_WRITE(0x40);
    I2C_WAIT_TRASMISSION();
    for(uint8_t i = 0 ; s[i] ; i++)
        for(uint8_t col = 0 ; col < 12 ; col++){
            uint8_t byte = pgm_read_byte(&charmap10x15[charToBigIndex(s[i])][col][0]);
            if(flags & ATTR_UNDERLINE) byte |= 0x80;
            if(flags & ATTR_STRICKTHR) byte |= 0x08;
            if(flags & ATTR_INVERTED) byte = ~byte;
            I2C_WRITE(byte);
            I2C_WAIT_TRASMISSION();
        }
    I2C_STOP();

    COMMAND_SSD1306(0x00 | (x & 0x0F));
    COMMAND_SSD1306(0x10 | (x >> 4));
    COMMAND_SSD1306(0xB0 | ((y+1) & 0x07));
    
    I2C_START();
    I2C_WAIT_TRASMISSION();
    I2C_WRITE(ADDR_W_SSD1306);
    I2C_WAIT_TRASMISSION();
    I2C_WRITE(0x40);
    I2C_WAIT_TRASMISSION();
    for(uint8_t i = 0 ; s[i] ; i++)
        for(uint8_t col = 0 ; col < 12 ; col++){
            uint8_t byte = pgm_read_byte(&charmap10x15[charToBigIndex(s[i])][col][1]);
            if(flags & ATTR_UNDERLINE) byte |= 0x80;
            if(flags & ATTR_STRICKTHR) byte |= 0x08;
            if(flags & ATTR_INVERTED) byte = ~byte;
            I2C_WRITE(byte);
            I2C_WAIT_TRASMISSION();
        }
    I2C_STOP();
}

void printUInt8_SSD1306(uint8_t x, uint8_t y, uint8_t v, int8_t filler, uint8_t flags){
    int8_t stringBuffer[4];
    uint8_t numBuffer;
    uint8_t index = 0, ok = 0;

    if(numBuffer = (v / 100)){
        stringBuffer[index++] = numBuffer + 0x30;
        if(!ok) ok = 1;
    }else if(filler) stringBuffer[index++] = filler;

    if((numBuffer = ((v / 10) % 10)) || ok){
        stringBuffer[index++] = numBuffer + 0x30;
        if(!ok) ok = 1;
    }else if(filler) stringBuffer[index++] = filler;

    stringBuffer[index++] = (v % 10) + 0x30;

    stringBuffer[index] = 0;

    printStr_SSD1306(x, y, stringBuffer, flags);
}

void printHex8_SSD1306(uint8_t x, uint8_t y, uint8_t v, uint8_t flags){
    int8_t stringBuffer[3];

    stringBuffer[0] = pgm_read_byte(&hexChars[(v >> 4) & 0x0F]);
    stringBuffer[1] = pgm_read_byte(&hexChars[v & 0x0F]);
    stringBuffer[2] = 0;

    printStr_SSD1306(x, y, stringBuffer, flags);
}

void printHex16_SSD1306(uint8_t x, uint8_t y, uint16_t v, uint8_t flags){
    int8_t stringBuffer[5];

    stringBuffer[0] = pgm_read_byte(&hexChars[(v >> 12) & 0x0F]);
    stringBuffer[1] = pgm_read_byte(&hexChars[(v >> 8) & 0x0F]);
    stringBuffer[2] = pgm_read_byte(&hexChars[(v >> 4) & 0x0F]);
    stringBuffer[3] = pgm_read_byte(&hexChars[v & 0x0F]);
    stringBuffer[4] = 0;

    printStr_SSD1306(x, y, stringBuffer, flags);
}

void printHex32_SSD1306(uint8_t x, uint8_t y, uint32_t v, uint8_t flags){
    int8_t stringBuffer[9];

    stringBuffer[0] = pgm_read_byte(&hexChars[(v >> 28) & 0x0F]);
    stringBuffer[1] = pgm_read_byte(&hexChars[(v >> 24) & 0x0F]);
    stringBuffer[2] = pgm_read_byte(&hexChars[(v >> 20) & 0x0F]);
    stringBuffer[3] = pgm_read_byte(&hexChars[(v >> 16) & 0x0F]);
    stringBuffer[4] = pgm_read_byte(&hexChars[(v >> 12) & 0x0F]);
    stringBuffer[5] = pgm_read_byte(&hexChars[(v >> 8) & 0x0F]);
    stringBuffer[6] = pgm_read_byte(&hexChars[(v >> 4) & 0x0F]);
    stringBuffer[7] = pgm_read_byte(&hexChars[v & 0x0F]);
    stringBuffer[8] = 0;

    printStr_SSD1306(x, y, stringBuffer, flags);
}
